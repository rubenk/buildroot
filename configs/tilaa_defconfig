## configs/tilaa_defconfig
```kconfig
BR2_x86_64=y
BR2_x86_core2=y
BR2_DEFCONFIG="$(CONFIG_DIR)/config/tilaa_defconfig"
BR2_CCACHE=y
BR2_OPTIMIZE_2=y
BR2_ENABLE_SSP=y
BR2_KERNEL_HEADERS_3_14=y
BR2_TOOLCHAIN_BUILDROOT_GLIBC=y
BR2_GLIBC_VERSION_2_19=y
BR2_BINUTILS_VERSION_2_24=y
BR2_GCC_VERSION_4_9_X=y
BR2_TOOLCHAIN_BUILDROOT_CXX=y
BR2_TARGET_GENERIC_PASSWD_SHA512=y
BR2_INIT_SYSTEMD=y
BR2_LINUX_KERNEL=y
BR2_LINUX_KERNEL_CUSTOM_VERSION=y
BR2_LINUX_KERNEL_CUSTOM_VERSION_VALUE="3.14.18"
BR2_LINUX_KERNEL_USE_CUSTOM_CONFIG=y
BR2_LINUX_KERNEL_CUSTOM_CONFIG_FILE="board/tilaa/linux.config"
BR2_LINUX_KERNEL_INSTALL_TARGET=y
BR2_PACKAGE_BUSYBOX_CONFIG="board/tilaa/busybox.config"
BR2_PACKAGE_LZ4=y
BR2_PACKAGE_READLINE=y
BR2_PACKAGE_IPROUTE2=y
BR2_PACKAGE_ACL=y
BR2_PACKAGE_SYSTEMD_NETWORKD=y
BR2_TARGET_ROOTFS_EXT2=y
BR2_TARGET_ROOTFS_EXT2_4=y
# BR2_TARGET_ROOTFS_TAR is not set
```
